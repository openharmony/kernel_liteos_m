## Kconfig
```kconfig
# Copyright (c) 2013-2019 Huawei Technologies Co., Ltd. All rights reserved.
# Copyright (c) 2020-2022 Huawei Device Co., Ltd. All rights reserved.
#
# Redistribution and use in source and binary forms, with or without modification,
# are permitted provided that the following conditions are met:
#
# 1. Redistributions of source code must retain the above copyright notice, this list of
#    conditions and the following disclaimer.
#
# 2. Redistributions in binary form must reproduce the above copyright notice, this list
#    of conditions and the following disclaimer in the documentation and/or other materials
#    provided with the distribution.
#
# 3. Neither the name of the copyright holder nor the names of its contributors may be used
#    to endorse or promote products derived from this software without specific prior written
#    permission.
#
# THIS SOFTWARE IS PROVIDED BY THE COPYRIGHT HOLDERS AND CONTRIBUTORS
# "AS IS" AND ANY EXPRESS OR IMPLIED WARRANTIES, INCLUDING, BUT NOT LIMITED TO,
# THE IMPLIED WARRANTIES OF MERCHANTABILITY AND FITNESS FOR A PARTICULAR
# PURPOSE ARE DISCLAIMED. IN NO EVENT SHALL THE COPYRIGHT HOLDER OR
# CONTRIBUTORS BE LIABLE FOR ANY DIRECT, INDIRECT, INCIDENTAL, SPECIAL,
# EXEMPLARY, OR CONSEQUENTIAL DAMAGES (INCLUDING, BUT NOT LIMITED TO,
# PROCUREMENT OF SUBSTITUTE GOODS OR SERVICES; LOSS OF USE, DATA, OR PROFITS;
# OR BUSINESS INTERRUPTION) HOWEVER CAUSED AND ON ANY THEORY OF LIABILITY,
# WHETHER IN CONTRACT, STRICT LIABILITY, OR TORT (INCLUDING NEGLIGENCE OR
# OTHERWISE) ARISING IN ANY WAY OUT OF THE USE OF THIS SOFTWARE, EVEN IF
# ADVISED OF THE POSSIBILITY OF SUCH DAMAGE.

mainmenu "Huawei LiteOS Configuration"

menu "Compiler"
choice
    prompt "Compiler type"
    default COMPILER_GCC
    help
      Choose compiler type.

config COMPILER_GCC
    bool "GCC"

config COMPILER_CLANG_LLVM
    bool "Clang"

config COMPILER_ICCARM
    bool "ICCARM"

endchoice

config COMPILE_DEBUG
    bool "Enable debug options"
    default n
    help
      Answer Y to add -g option in compile command.

config COMPILE_OPTIMIZE
    bool "Enable code optimization options"
    default y
    help
      Answer Y to add optimization options for efficient code.
      The final binary size will be smaller and execute faster.
      But the debugging experience may be worst somehow.

config COMPILE_OPTIMIZE_SIZE
    bool "Enable code size optimization options" if COMPILE_OPTIMIZE
    default y
    help
      Answer Y to add optimization options for small code size.
      The final binary size will be smaller.
      But the compile time may be a bit longer.

config COMPILE_LTO
    bool "Enable link time optimization (LTO)" if COMPILE_OPTIMIZE_SIZE
    default y
    help
      Answer Y to add lto options for more smaller code size.
      The final binary size will be smaller.
      But the compile time may be much longer.

endmenu

menu "Platform"

######################### config options of bsp #####################
config PLATFORM
    string
    default "virt"            if PLATFORM_QEMU_ARM_VIRT_CM7 || PLATFORM_QEMU_ARM_VIRT_CM4 || PLATFORM_QEMU_ARM_VIRT_CM55 || PRODUCT_QEMU_RISCV32_VIRT || PLATFORM_QEMU_CSKY_SMARTL || PLATFORM_QEMU_XTENSA_ESP32

config DEVICE_COMPANY
    string
    default "qemu" if PLATFORM_QEMU_ARM_VIRT_CM7 || PLATFORM_QEMU_ARM_VIRT_CM4 || PLATFORM_QEMU_ARM_VIRT_CM55 || PRODUCT_QEMU_RISCV32_VIRT || PLATFORM_QEMU_CSKY_SMARTL || PLATFORM_QEMU_XTENSA_ESP32

choice
    prompt "Chip"
    default PLATFORM_QEMU_ARM_VIRT_CM7
    help
      Qemu ARM Virt variants (based on different CPU types):
       - qemu_arm_virt_cm7
       - qemu_arm_virt_cm4
       - qemu_riscv32_virt
       - qemu_csky_smartl
       - qemu_xtensa_esp32

config PLATFORM_QEMU_ARM_VIRT_CM7
    bool "qemu_arm_virt_cm7"
    select ARCH_CORTEX_M7
    help
        QEMU ARM Virtual Platform using Cortex-M7 CPU.

config PLATFORM_QEMU_ARM_VIRT_CM4
    bool "qemu_arm_virt_cm4"
    select ARCH_CORTEX_M4
    help
        QEMU ARM Virtual Platform using Cortex-M4 CPU.

config PLATFORM_QEMU_ARM_VIRT_CM55
    bool "qemu_arm_virt_cm55"
    select ARCH_CORTEX_M55
    help
        QEMU ARM Virtual Platform using Cortex-M55 CPU.

config PLATFORM_QEMU_RISCV32_VIRT
    bool "qemu_riscv32_virt"
    select ARCH_RISCV32
    help
        QEMU RISCV Virtual Platform using riscv32 CPU.

config PLATFORM_QEMU_CSKY_SMARTL
    bool "qemu_csky_smartl"
    select ARCH_CSKY
    help
        QEMU SmartL Virtual Platform using csky CPU.

config PLATFORM_QEMU_XTENSA_ESP32
    bool "qemu_xtensa_esp32"
    select ARCH_XTENSA
    help
        QEMU ESP32 Virtual Platform using xtensa CPU.

config PLATFORM_WS63_M
    bool "ws63_m"
    select ARCH_RISCV32
    help
        HiSilicon WS63 NearLink DK 3863 board (RISC-V LinxCore131).

config PLATFORM_NRF52832
    bool "nrf52832"
    select ARCH_CORTEX_M4
    help
        Nordic nRF52832 dev board (ARM Cortex-M4F, 512KB Flash / 64KB RAM).

config PLATFORM_HI3322
    bool "hi3322"
    select ARCH_RISCV32
    help
        HiSilicon HI3322 wearable SoC (RISC-V LinxCore).

endchoice

choice
    prompt "Product"
    help
      Select your target board.

config PRODUCT_QEMU_RISCV32_VIRT
    bool "riscv32_virt" if PLATFORM_QEMU_RISCV32_VIRT

endchoice


######################### config options of cpu arch ################
source "arch/Kconfig"

# Device Kconfig import
osource "$(DEVICE_PATH)/Kconfig"

config SOC_COMPANY
    string "SoC company name to locate soc build path"
    help
      This option specifies the SoC company name, used to locate the build path for soc. This option is set by the
      SoC's Kconfig file, and should be exactly the same with SoC company path, and the user should generally avoid
       modifying it via the menu configuration.

orsource "../../device/board/*/Kconfig.liteos_m.shields"

orsource "../../device/board/$(BOARD_COMPANY)/Kconfig.liteos_m.defconfig.boards"

choice
    prompt "Board Selection"

orsource "../../device/board/$(BOARD_COMPANY)/Kconfig.liteos_m.boards"

endchoice

orsource "../../device/soc/*/Kconfig.liteos_m.defconfig"

choice
    prompt "SoC Series Selection"

orsource "../../device/soc/*/Kconfig.liteos_m.series"

endchoice

orsource "../../device/soc/*/Kconfig.liteos_m.soc"

endmenu

######################### config options of kernel #####################
rsource "kernel/Kconfig"

######################### config options of compatibility ##############
menu "Compat"

rsource "compat/Kconfig"
rsource "lib/Kconfig"

endmenu

######################## config options of filesystem ##################
menu "FileSystem"

rsource "fs/Kconfig"

endmenu

######################## config options of net ############################
menu "Net"
config NET_LWIP
    bool "Enable Lwip"
    default n
    select NET_LWIP_SACK

    help
      Answer Y to enable LiteOS support lwip.

config NET_LWIP_SACK
    bool
    default n

endmenu

######################## config options of debug ########################
menu "Debug"

config THUMB
    bool "Enable Thumb"
    default n
    depends on ARCH_ARM
    help
      Answer Y to build thumb version.  This will make LiteOS smaller.

config DEBUG_VERSION
    bool "Enable a Debug Version"
    default y
    help
      If you do not select this option that means you enable a release version for LiteOS.
      It also means you do not want to use debug modules, like shell,telnet,tftp,nfs and
      memory check, etc.
      If you select this option that means you enable a debug version for LiteOS.
      That means you want a opposite behaviour compared to release version.

config DEBUG_KERNEL
    bool "Enable Debug LiteOS Kernel Resource"
    default n
    depends on DEBUG_VERSION
    help
      If you select this option that means you enable debugging kernel resource.
      It also means you want to get queue, mutex, semaphore, memory debug information.
      That means you want a opposite behaviour compared to release version.

config MUTEX_CREATE_TRACE
    bool "Enable Mutex Trace Debugging"
    default n
    depends on ARCH_ARM
    depends on DEBUG_KERNEL
    help
      Answer Y to enable debug mutex trace.

config NET_LWIP_SACK_TFTP
    bool "Enable Tftp"
    default y
    depends on SHELL && NET_LWIP_SACK && DEBUG_VERSION
    help
      Answer Y to enable LiteOS support tftp cmd and tftp tool.

config DEBUG_HOOK
    bool "Enable Hook Framework"
    default n
    depends on DEBUG_VERSION
    help
      Enable the kernel hook framework to support customized trace information capture.

config SHELL_CMD_DEBUG
    bool "Enable shell cmd Debug"
    default n
    depends on DEBUG_VERSION && SHELL

config DEBUG_TOOLS
    bool "Enable DEBUG TOOLS"
    default n
    depends on DEBUG_VERSION
    help
      Answer Y to enable LiteOS debug tools, include stackdump, hwidump, tasktrack.

config MEM_DEBUG
    bool "Enable MEM Debug"
    default n
    depends on DEBUG_VERSION
    help
      Answer Y to enable LiteOS support mem debug.

config MEM_LEAKCHECK
    bool "Enable Function call stack of Mem operation recorded"
    default n
    depends on DEBUG_VERSION && MEM_DEBUG
    depends on KERNEL_MEM_TLSF || KERNEL_MEM_BESTFIT
    # TLSF + MEM_FREE_BY_TASKID uses a 26-bit bitfield for sizeAndFlag, where
    # LEAK_FLAG (1U<<23) overlaps with size bit 23 for heaps > 8MB, corrupting
    # GET_SIZE. bestfit uses a full UINT32 and is unaffected.
    depends on !(KERNEL_MEM_TLSF && MEM_FREE_BY_TASKID)
    select KERNEL_BACKTRACE
    help
      Answer Y to enable record the LR of Function call stack of Mem operation, it can check the mem leak through the information of mem node.

config MEM_OMIT_LR_CNT
    int "Number of ignored layers for backtrace."
    default 3
    depends on MEM_LEAKCHECK
    help
      The omit layers of function call from kernel memory interfaces such as LOS_MemAlloc/LOS_MemAllocAlign/LOS_MemRealloc/LOS_MemFree.

config MEM_RECORD_LR_CNT
    int "Number of layers for backtrace."
    default 4
    depends on MEM_LEAKCHECK
    help
      The record number of layers of the function call relationship starting from the number of
      ignored layers(LOSCFG_MEM_OMIT_LR_CNT).

config BASE_MEM_NODE_INTEGRITY_CHECK
    bool "Enable integrity check or not"
    default n
    depends on DEBUG_VERSION && MEM_DEBUG
    depends on KERNEL_MEM_TLSF || KERNEL_MEM_BESTFIT

config MEM_WATERLINE
    bool "Enable memory pool waterline or not"
    default n
    depends on DEBUG_VERSION && MEM_DEBUG
    depends on KERNEL_MEM_TLSF

config TASK_MEM_USED
    bool "Enable show task mem used or not"
    default n
    depends on DEBUG_VERSION && MEM_DEBUG
    depends on KERNEL_MEM_TLSF

config MEM_HEAD_BACKUP
    bool "Enable Node Head Backup"
    default n
    depends on MEM_DEBUG && KERNEL_MEM_BESTFIT
    help
      Answer Y to enable node head backup

config BASE_MEM_NODE_SIZE_CHECK
    bool "Enable size check or not"
    default n
    depends on MEM_DEBUG && KERNEL_MEM_BESTFIT

config SHELL_EXCINFO_DUMP
    bool "Enable shell exception info dump"
    default n
    depends on PLATFORM_EXC
    help
      Answer Y to enable exception info dump framework. When enabled, the
      kernel records exception information into a buffer via registered
      dump hook, so that the information can be persisted (e.g. to flash)
      and later read back for diagnosis.

source "shell/Kconfig"

endmenu

######################## config options os drivers ########################
menu "Driver"
source "drivers/Kconfig"
endmenu

######################## config options os security #######################
menu "Security"
config SECURE_TRUSTZONE
    bool "Enable ARM TrustZone"
    default n
    depends on ARCH_ARM
    depends on ARCH_ARM_V8M
config SECURE_HEAP_SIZE
    int "TrustZone Heap Size (bytes)"
    default 2048
    depends on SECURE_TRUSTZONE
config SECURE
    bool "Enable Security"
    default n
    select MPU_ENABLE
config MPU_ENABLE
    bool "Enable MPU"
    default n
endmenu

menu "Test"
config TEST
    bool
    default n
config KERNEL_TEST
    bool "Enable Kernel Test"
    default n
    select TEST
config KERNEL_TEST_FULL
    bool "Full Kernel Test"
    default n
    depends on KERNEL_TEST
config KERNEL_TEST_MANUAL
    bool "Manual Kernel Test"
    default n
    depends on KERNEL_TEST
endmenu

menu "Stack Smashing Protector (SSP) Compiler Feature"

choice
    prompt "Enable stack buffer overflow detection"
    default  CC_STACKPROTECTOR_STRONG
    ---help---
    This option turns on the -fstack-protector GCC feature. This
    feature puts, at the beginning of functions, a canary value on
    the stack just before the return address, and validates
    the value just before actually returning.  Stack based buffer
    overflows (that need to overwrite this return address) now also
    overwrite the canary, which gets detected and the attack is then
    neutralized via a kernel panic.

    This feature requires gcc version 4.2 or above, or a distribution
    gcc with the feature backported. Older versions are automatically
    detected and for those versions, this configuration option is
    ignored. (and a warning is printed during bootup)

config CC_NO_STACKPROTECTOR
    bool "-fno-stack-protector"

config CC_STACKPROTECTOR
    bool "-fstack-protector"

config CC_STACKPROTECTOR_STRONG
    bool "-fstack-protector-strong"

config CC_STACKPROTECTOR_ALL
    bool "-fstack-protector-all"

endchoice

endmenu
```

## arch/Kconfig
```kconfig
config ARCH_ARM
   bool

rsource "arm/Kconfig"

config ARCH_CSKY
   bool

config ARCH_RISCV
   bool

config ARCH_RISCV32
   bool
   select ARCH_RISCV

config ARCH_RISCV_HW_ATOMIC
    bool "RISC-V hardware Atomic (A) extension is available"
    depends on ARCH_RISCV
    default n
    help
      Select this if the RISC-V core implements the standard Atomic (A)
      extension in hardware (lr.w/sc.w/amoadd.w/amoswap.w ...). When
      selected, the arch atomic operations use A-extension instructions;
      otherwise they fall back to interrupt-lock (LOS_IntLock) based
      atomics, which is correct for single-core but disables interrupts
      during each operation.

config ARCH_XTENSA
   bool

comment "Extra Configurations"

config ARCH_FPU_DISABLE
    bool "Disable Floating Pointer Unit"
    default n
    help
      This option will bypass floating procedure in system.

config ARCH_UNALIGNED_EXC
    bool "Enable Unaligned Exception"
    default y
    depends on ARCH_ARM
    help
     This option will enable unaligned exception.

config ARCH_TIMER_VENDOR
    bool "Use vendor-provided timer instead of arch default"
    default n
    help
      Select this if the board has a custom timer (not SiFive CLINT).
      The board must provide its own ArchSysTickTimerGet() and ArchEnterSleep().

config ARCH_INTERRUPT_VENDOR
    bool "Use vendor-provided interrupt controller instead of arch default"
    default n
    help
      Select this if the board has a custom interrupt controller (not the
      default liteos_m g_hwiForm dispatch). The board must provide its own
      g_hwiForm, HalHwiInterruptDone, ArchHwiCreate, HalExcEntry, HalHwiInit,
      and all symbols that los_interrupt.c would normally provide.
```
