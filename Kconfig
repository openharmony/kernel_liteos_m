## drivers/interrupt/Kconfig
```kconfig
# Interrupt controller drivers.
# Each board selects the controller(s) for its platform explicitly
# (LOSCFG_<CONTROLLER>=y in kernel_configs/debug.config); only the
# selected driver source is compiled into the interrupt module (see
# BUILD.gn). One controller per platform — co-selection would be a
# duplicate-symbol link error (each driver defines its own
# g_hwiControllerOps + HwiControllerOpsGet).

config RISCV_LCMP_CLIC
    bool "RISC-V LCMP CLIC interrupt controller"
    depends on ARCH_RISCV
    select ARCH_INTERRUPT_TAKEOVER
    help
      RISC-V Core-Local Interrupt Controller (CLIC) for LinxCore.
      Used by HI3322. Does not auto-clear pending bits (unlike PLIC).

config RISCV_HIMIDEERV200_PLIC
    bool "HiSilicon himideerv200 PLIC interrupt controller"
    depends on ARCH_RISCV
    select ARCH_INTERRUPT_TAKEOVER
    help
      HiSilicon himideerv200 Platform Level Interrupt Controller for
      WS63 (riscv31 core). CSR-based (no memory map): vectors 0..31
      via mie/mip, 32..95 via LOCIEN0/1. Source replacement for the
      prebuilt libinterrupt.a. Software trigger is not supported.

config ARM_GIC_V2
    bool "ARM GICv2 interrupt controller"
    depends on ARCH_ARM_AARCH32
    select ARCH_INTERRUPT_TAKEOVER
    help
      ARM Generic Interrupt Controller v2. Used by Cortex-A7
      (Hi3516DV300, QEMU ARM virt). Compatible with GICv1.

config CORTEX_M_NVIC
    bool "ARM Cortex-M NVIC interrupt controller"
    depends on ARCH_CORTEX_M3 || ARCH_CORTEX_M4 || ARCH_CORTEX_M7 || ARCH_CORTEX_M33 || ARCH_CORTEX_M55
    select ARCH_INTERRUPT_TAKEOVER
    help
      ARM Nested Vectored Interrupt Controller, built into all
      Cortex-M cores (register layout per ARMv7-M). All Cortex-M
      variants (m3/m4/m7/m33/m55, gcc/iar/keil) consume the shared
      driver-layer implementation in arm_nvic.c.
```

## drivers/timer/Kconfig
```kconfig
config CORTEX_M_SYSTICK
    bool "ARM Cortex-M SysTick"
    default n
    depends on ARCH_CORTEX_M3 || ARCH_CORTEX_M4 || ARCH_CORTEX_M7 || ARCH_CORTEX_M55
    select ARCH_TIMER_VENDOR
    select TIMER_ARCH_BRIDGE
    help
      ARM Cortex-M SysTick timer (M3/M4/M7/M55).

config DW_APB_TIMER
    bool "DW APB dual timer (Synopsys) as system tick"
    default n
    depends on ARCH_RISCV32
    depends on !KERNEL_TICKLESS_GLOBAL
    select ARCH_TIMER_VENDOR
    help
      Synopsys DesignWare APB dual timer as system tick (RISC-V boards).
      Reserved for the RISC-V timer MR: dw_apb_timer.c lands there. Board
      contract (asm/register_config.h / soc.h): DW_APB_TIMER_BASE is
      required; DW_APB_TIMER_IRQ, DW_APB_TIMER_CLOCK, DW_APB_TIMER_IRQ_PRIO,
      DW_APB_TIMER_LOCK_BASE, DW_APB_TIMER_UNLOCK_VAL are optional, with
      DW_APB_TIMER_NEED_UNLOCK / DW_APB_TIMER_LOAD_WO / DW_APB_TIMER_EOI_FENCE
      quirks as the SoC requires. The board must provide
      HalIrqEnable/HalIrqDisable. ArchSysTickTimerGet/ArchEnterSleep are
      exported weak, so a future board can still override.

      Depends on !KERNEL_TICKLESS_GLOBAL: the reload callback is a no-op in
      periodic mode, so tickless would silently degrade to plain periodic
      ticking (timer keeps firing every tick, no idle-window savings).
      Proper tickless needs one-shot reload support plus a working getCycle
      (CURRENT_BROKEN quirk); remove this dependency only together with
      that work.

config TIMER_ARCH_BRIDGE
    bool "Bridge HAL timer drivers to ArchTickTimer"
    default n
    depends on CORTEX_M_SYSTICK
    help
      Adapter that wraps a HAL timer driver (HalClockInit/Start/GetCycles,
      hal_timer.h) into the liteos_m ArchTickTimer interface, exporting a
      weak ArchSysTickTimerGet. The SysTick driver (cortex_m_systick.c) has
      no native table and is the current consumer; drivers with a native
      ArchTickTimer table (dw_apb_timer.c) do not need this bridge.
      OS_SYS_CLOCK must match the HAL timer input clock. Limitations:
      tickHandler override unsupported (a non-OsTickHandler handler logs a
      warning); a HAL driver without one-shot reload degrades tickless to
      periodic ticking; init() fails loudly unless HalClockIsRunning()
      confirms the counter is up (weak default TRUE). lock/unlock are the
      PM tick-lock pair (see HalClockTickTimerLock/Unlock).

# The LOSCFG_KERNEL_LOWPOWER-guarded HAL blocks (HalTickAdjust etc.) stay
# although liteos_m has no LOWPOWER: they compile out and preserve the
# driver contract for a future lowpower framework. Do not remove them.
```
