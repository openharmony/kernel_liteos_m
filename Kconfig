## kernel/base/mem/Kconfig
```kconfig
menu "Memory Management"

config KERNEL_MEM_ALLOC
    bool "Dynamic Memory Management"
    default y

if KERNEL_MEM_ALLOC
choice
    prompt "Dynamic Memory Management Algorithm"
    default KERNEL_MEM_TLSF

config KERNEL_MEM_TLSF
    bool "tlsf"
    help
      This option will change mem type as tlsf

config KERNEL_MEM_BESTFIT
    bool "bestfit"
    help
      This option will change mem type as bestfit

config KERNEL_MEM_BESTFIT_LITTLE
    bool "bestfit_little"
    help
      This option will change mem type as bestfit little
endchoice

config MEM_FREE_BY_TASKID
    bool "Enable Mem Free By Task"
    default n
    depends on KERNEL_MEM_TLSF

config KERNEL_MEM_SLAB_EXTENTION
    bool "Enable Mem SLAB Extension"
    default n
    depends on KERNEL_MEM_ALLOC
    depends on KERNEL_MEM_BESTFIT || KERNEL_MEM_BESTFIT_LITTLE

config KERNEL_MEM_SLAB_AUTO_EXPANSION_MODE
    bool "Enable Mem SLAB Auto Expansion Mode"
    default n
    depends on KERNEL_MEM_SLAB_EXTENTION

config MEM_TASK_STAT
    bool "Enable Memory Task Usage Statistics"
    default n
    depends on KERNEL_MEM_BESTFIT || KERNEL_MEM_BESTFIT_LITTLE
    help
      Answer Y to enable LiteOS support memory task statistics

config MEM_MUL_POOL
    bool "Enable Memory multi-pool control"
    default y
    depends on KERNEL_MEM_BESTFIT || KERNEL_MEM_BESTFIT_LITTLE || KERNEL_MEM_TLSF
    help
      Answer Y to enable LiteOS support memory multi-pool control

config MEM_MUL_POOL_ALLOC
    bool "Enable Memory multi-pool alloc"
    default n
    depends on MEM_MUL_POOL && KERNEL_MEM_BESTFIT
    help
      Answer Y to enable LiteOS support memory multi-pool alloc

config MEM_MUL_MODULE
    bool "Enable Memory module statistics"
    default n
    depends on KERNEL_MEM_BESTFIT
    help
      Answer Y to enable LiteOS support memory statistics depend on different module

config MEM_MODULE_MAX
    int "Max Memory Module Number"
    default 32
    range 8 1024
    depends on MEM_MUL_MODULE
    help
      This represents the maximum number of Memory Module
endif

config KERNEL_MEMBOX
    bool "Membox Management"
    default y

choice
    prompt "Membox Management Algorithm"
    default KERNEL_MEMBOX_STATIC
    depends on KERNEL_MEMBOX

config KERNEL_MEMBOX_STATIC
    bool "static memory"
    help
      This option will change membox implemented with input memory

config KERNEL_MEMBOX_DYNAMIC
    bool "dynamic memory"
    depends on KERNEL_MEM_ALLOC
    help
      This option will change membox implemented with dynamic allocated memory

endchoice

endmenu
```

## kernel/extended/signal/Kconfig
```kconfig
config KERNEL_SIGNAL
    bool "Enable Signal"
    default n if KERNEL_RAM_PRESET_TINY || KERNEL_RAM_PRESET_SMALL
    default y
    depends on KERNEL_EXTKERNEL
    help
      Select y to build LiteOS with signal.
```

## shell/Kconfig
```kconfig
config SHELL
    bool "Enable Shell"
    default n
    depends on DEBUG_VERSION
    select USE_SHELL
    help
      Answer Y to enable LiteOS support shell cmd.

config USE_SHELL
    bool
    default n

menu "Functionality of Shell"
    depends on SHELL

config SHELL_PRIO
    int "Shell Task Priority"
    default 3
    range 1 31
    depends on SHELL

config SHELL_STACK_SIZE
    int "Shell Task Stack Size"
    default 4096
    depends on SHELL

config SHELL_LK
    bool "Enable Shell LK (Logger)"
    default y
    depends on SHELL
    help
      Answer Y to enable LiteOS shell LK (logger) subsystem. When enabled,
      LOS_LkPrint / LOS_LkRegHook are available and the kernel printf path
      routes through the LK hook for level-based filtering. The default trace
      level is LOS_ERR_LEVEL (2). See shell_lk.h for the public API.

config SHELL_DMESG
    bool "Enable Shell Dmesg"
    default n
    depends on SHELL
    help
      Answer Y to enable LiteOS shell dmesg subsystem. When enabled, an 8KB
      ring buffer captures kernel log output and the LOS_Dmesg* public API
      becomes available. The kernel printf path (los_printf.c UartOutput)
      automatically records into the dmesg buffer via OsLogMemcpyRecord.
      See dmesg.h for the public API.

endmenu
```
